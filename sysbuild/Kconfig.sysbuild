## sysbuild/Kconfig.sysbuild
```kconfig
#
# Copyright (c) 2025, Jamie M.
#
# All right reserved. This code is NOT apache or FOSS/copyleft licensed.
#

config APP_USE_COMBINED_HEX_FILE
	bool "Use combined hex file"
	help
	  Use combined hex file with application and flipper core images in
```

## west.yml
```yaml
manifest:
  remotes:
    - name: zephyr
      url-base: https://github.com/zephyrproject-rtos
    - name: nrfconnect
      url-base: https://github.com/nrfconnect
    - name: thedjnK
      url-base: https://github.com/thedjnK

  projects:
    - name: sdk-nrf
      path: nrf
      remote: nrfconnect
      revision: d3c1da02e942ebc1b105ce7027b468351ec47185
      import:
        name-allowlist:
          - cmsis
          - cmsis_6
          - hal_nordic
          - loramac-node
          - mbedtls
          - mcuboot
          - nrfxlib
          - oberon-psa-crypto
          - picolibc
          - tinycrypt
          - zcbor
          - zephyr
          - segger
    - name: boards
      remote: thedjnK
      revision: main

  self:
    path: lora-hacks-ng
```
